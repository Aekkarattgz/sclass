#include <WiFi.h>
#include <PubSubClient.h>

#include <Wire.h>

#include <Arduino.h>
#include <IRremoteESP8266.h>
#include <IRsend.h>

const char* ssid     = "WIFI";
const char* password = "PASSWORDWIFI";
const char* mqtt_server = "IPSERVER";
const int mqtt_port = 1883;
const char* mqtt_Client = "USERCLIENT";
const char* mqtt_username = "USERSERVER";
const char* mqtt_password = "PASSWORDSERVER";

int analog_value = 0;
char msg[100];
long lastMsg = 0;
WiFiClient espClient;
PubSubClient client(espClient);

//const uint16_t kIrLed2 = 18;

IRsend irsend1(kIrLed1);  // Set the GPIO to be used to sending the message.
//IRsend irsend2(kIrLed2);

float readlight() {
  analog_value = analogRead(36);
  if (analog_value > 1000) {
    analog_value = 1000;
  }
  int light = (1000 - analog_value) * 100 / 1000;
  return light;
}

void reconnect() {
  while (!client.connected()) {
    Serial.print("Attempting SCLASS connection…");
    client.publish("/data_update_Borad", "{Board is connecting}");
    if (client.connect(mqtt_Client, mqtt_username, mqtt_password)) {
      Serial.println("SCLASS CLASS 44-702 connected");
      client.subscribe("/Air");
      digitalWrite(LED_BUILTIN, 1);
      client.publish("/data_update_Borad", "{Bpard connect to Server}");
    }
    else {
      digitalWrite(LED_BUILTIN, 0);
      client.publish("/data_update_Borad", "{Board connection error}");
      Serial.print("failed, rc=");
      Serial.print(client.state());
      Serial.println("try again in 5 seconds");
      delay(5000);
    }
  }
}


// Example of data captured by IRrecvDumpV2.ino
//////////////////////////////////////////////////////////////////////////
uint16_t rawData_ON18[131] = {9244, 4462,  642, 462,  590, 1568,  588, 1566,  640, 464,  588, 1566,  642,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 464,  508};  // UNKNOWN 4866B7C7
uint16_t rawData_ON19[131] = {9238, 4466,  638, 466,  584, 1572,  586, 1570,  640, 466,  584, 1570,  640,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 470,  500};  // CARRIER_AC64 10E0890000002216
uint16_t rawData_ON20[131] =  {9268, 4436,  666, 438,  610, 1546,  610, 1546,  664, 440,  610, 1548,  662,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 442,  536};  // UNKNOWN 9D0C3D52
uint16_t rawData_ON21[131] =  {9244, 4462,  640, 464,  588, 1568,  588, 1570,  640, 462,  590, 1568,  642,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 464,  508};  // UNKNOWN 303F7905
uint16_t rawData_ON22[131] = {9264, 4442,  658, 446,  606, 1548,  610, 1548,  644, 462,  608, 1548,  660,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 464,  508};  // UNKNOWN 1B7B4685
uint16_t rawData_ON23[131] = {9244, 4462,  642, 464,  586, 1568,  590, 1566,  642, 462,  588, 1568,  642,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 464,  508};  // UNKNOWN D075A9D3
uint16_t rawData_ON24[131] = {9240, 4464,  638, 466,  584, 1572,  584, 1570,  638, 468,  586, 1570,  636,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 526,  446};  // UNKNOWN 632A90D3
uint16_t rawData_ON25[131] = {9268, 4466,  638, 466,  586, 1570,  586, 1570,  638, 466,  610, 1546,  638,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 468,  506};  // UNKNOWN 40588247
uint16_t rawData_ON26[131] = {9244, 4462,  640, 464,  586, 1568,  588, 1568,  640, 464,  588, 1568,  642,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 466,  508};  // UNKNOWN 2B944FC7
uint16_t rawData_ON27[131] = {9242, 4464,  638, 466,  584, 1572,  584, 1574,  634, 470,  582, 1574,  636,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 470,  502};  // UNKNOWN 978A7921
uint16_t rawData_ON28[131] = {9234, 4472,  634, 470,  578, 1578,  582, 1576,  628, 476,  580, 1578,  632,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 526,  446};  // UNKNOWN E9888F61
uint16_t rawData_ON29[131] = {9244, 4460,  642, 462,  588, 1568,  588, 1568,  640, 464,  588, 1568,  642,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 464,  510};  // UNKNOWN C854C16D
uint16_t rawData_ON30[131] = {9232, 4474,  632, 474,  526, 1630,  578, 1578,  626, 480,  576, 1580,  632,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 526,  446};  // UNKNOWN B3908EED
uint16_t rawData_OFF[131] = {9244, 4462,  640, 462,  588, 1568,  588, 1568,  640, 464,  640, 464,  630,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 464,  508};  // UNKNOWN 8843AF63
//////////////////////////////////////////////////////////////////////////
/*------------------------------------------------------------------------*/
void callback(char* topic, byte* payload, unsigned int length) {
  payload[length] = '\0';
  String topic_str = topic, payload_str = (char*)payload;
  Serial.println("[" + topic_str + "]: " + payload_str);
  String message;

  for (int i = 0; i < length; i++) {
    message = message + (char)payload[i];
  }
  Serial.println(message);
  /////////////////////////////////////////////////////////////////////////////////////////////
  if (String(topic) == "/Air") {
    if (message == "18") {
      irsend1.sendRaw(rawData_ON18, 131, 38);
      //irsend2.sendRaw(rawData_ON18, 131, 38);
    }
    else if (message == "19") {
      irsend1.sendRaw(rawData_ON19, 131, 38);
     // irsend2.sendRaw(rawData_ON19, 131, 38);
    }
    else if (message == "20") {
      irsend1.sendRaw(rawData_ON20, 131, 38);
      // irsend2.sendRaw(rawData_ON20, 131, 38);
    }
    else if (message == "21") {
      irsend1.sendRaw(rawData_ON21, 131, 38);
      // irsend2.sendRaw(rawData_ON21, 131, 38);
    }
    else if (message == "22") {
      irsend1.sendRaw(rawData_ON22, 131, 38);
      // irsend2.sendRaw(rawData_ON22, 131, 38);
    }
    else if (message == "23") {
      irsend1.sendRaw(rawData_ON23, 131, 38);
     // irsend2.sendRaw(rawData_ON23, 131, 38);
    } 
    else if (message == "24") {
      irsend1.sendRaw(rawData_ON24, 131, 38);
     // irsend2.sendRaw(rawData_ON24, 131, 38);
    }
    else if (message == "25") {
      irsend1.sendRaw(rawData_ON25, 131, 38);
     // irsend2.sendRaw(rawData_ON25, 131, 38);
    }
    else if (message == "26") {
      irsend1.sendRaw(rawData_ON26, 131, 38);
     // irsend2.sendRaw(rawData_ON26, 131, 38);
    }
    else if (message == "27") {
      irsend1.sendRaw(rawData_ON27, 131, 38);
     // irsend2.sendRaw(rawData_ON27, 131, 38);
    }
    else if (message == "28") {
      irsend1.sendRaw(rawData_ON28, 131, 38);
    //  irsend2.sendRaw(rawData_ON28, 131, 38);
    }
    else if (message == "29") {
      irsend1.sendRaw(rawData_ON29, 131, 38);
    //  irsend2.sendRaw(rawData_ON29, 131, 38);
    }
    else if (message == "30") {
      irsend1.sendRaw(rawData_ON30, 131, 38);
    //  irsend2.sendRaw(rawData_ON30, 131, 38);
    }
    else if (message == "on") {
      irsend1.sendRaw(rawData_ON25, 131, 38);
     // irsend2.sendRaw(rawData_ON25, 131, 38);
    }
    else if (message == "off") {
      irsend1.sendRaw(rawData_OFF, 131, 38);
     // irsend2.sendRaw(rawData_OFF, 131, 38);
    }
  }

}
void setup() {
  irsend1.begin();
  //irsend2.begin();
#if ESP8266
  Serial.begin(115200, SERIAL_8N1, SERIAL_TX_ONLY);
#else  // ESP8266
  Serial.begin(115200, SERIAL_8N1);
#endif  // ESP8266
  Serial.println("Starting...");
  if (WiFi.begin(ssid, password)) {
    while (WiFi.status() != WL_CONNECTED) {
      delay(1000);
      Serial.print(".");
    }
  }
  Serial.println("WiFi connected");
  Serial.println("IP address: ");
  Serial.println(WiFi.localIP());
  client.setServer(mqtt_server, mqtt_port);
  client.setCallback(callback);

  pinMode(LED_BUILTIN, OUTPUT);

};
/*------------------------------------------------------------------------*/
void loop() {
  if (!client.connected()) {
    reconnect();
  }
  client.loop();
  String place = "44-704";

  long now = millis();
  if (now - lastMsg > 10000) {
    lastMsg = now;
    String data = "{\"data\": {\"place\": \"" +  String(place) + "\"}}";
    //   Serial.println(data);
    // Serial.println(Ling_Row1);
    data.toCharArray(msg, (data.length() + 1));
    client.publish("@shadow/data/update", msg);
  }
  delay(1);
};
/*------------------------------------------------------------------------*/
